#include "dactyl_manuform_5x6.dtsi"

&default_transform { // The matrix transform for this board is 6 columns over because the left half is 6 columns wide according to the matrix.
    col-offset = <6>;
};

&kscan0 {
    col-gpios
        = <&gpio0 31  GPIO_ACTIVE_HIGH>
        , <&gpio0 9   GPIO_ACTIVE_HIGH>
        , <&gpio0 10  GPIO_ACTIVE_HIGH>
        , <&gpio1 11  GPIO_ACTIVE_HIGH>
        , <&gpio1 13  GPIO_ACTIVE_HIGH>
        , <&gpio1 15  GPIO_ACTIVE_HIGH>
        ;

    row-gpios
        = <&gpio1 6   (GPIO_ACTIVE_HIGH | GPIO_PULL_DOWN)>
        , <&gpio1 4   (GPIO_ACTIVE_HIGH | GPIO_PULL_DOWN)>
        , <&gpio0 11  (GPIO_ACTIVE_HIGH | GPIO_PULL_DOWN)>
        , <&gpio1 0   (GPIO_ACTIVE_HIGH | GPIO_PULL_DOWN)>
        , <&gpio0 24  (GPIO_ACTIVE_HIGH | GPIO_PULL_DOWN)>
        , <&gpio0 22  (GPIO_ACTIVE_HIGH | GPIO_PULL_DOWN)>
        , <&gpio0 20  (GPIO_ACTIVE_HIGH | GPIO_PULL_DOWN)>
        ;
};