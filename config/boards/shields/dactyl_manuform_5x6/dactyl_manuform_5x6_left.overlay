#include "dactyl_manuform_5x6.dtsi" // Notice that the main dtsi files are included in the overlay.

&kscan0 {
    col-gpios
			= <&gpio0 9   GPIO_ACTIVE_HIGH>  
			, <&gpio0 10  GPIO_ACTIVE_HIGH>  
            , <&gpio1 11  GPIO_ACTIVE_HIGH>  
			, <&gpio1 13  GPIO_ACTIVE_HIGH>  
			, <&gpio1 15  GPIO_ACTIVE_HIGH>  
			, <&gpio0 2   GPIO_ACTIVE_HIGH>
            , <&gpio0 29  GPIO_ACTIVE_HIGH>
            , <&gpio0 31  GPIO_ACTIVE_HIGH>  
			;

	row-gpios
            = <&gpio1 6   GPIO_ACTIVE_HIGH>  
			, <&gpio1 4   GPIO_ACTIVE_HIGH>  
            , <&gpio1 11  GPIO_ACTIVE_HIGH>  
			, <&gpio1 0   GPIO_ACTIVE_HIGH>  
			, <&gpio0 24  GPIO_ACTIVE_HIGH>  
			, <&gpio0 22  GPIO_ACTIVE_HIGH>
            , <&gpio0 20  GPIO_ACTIVE_HIGH>  
			;
};