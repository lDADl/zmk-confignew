## config/boards/shields/dactyl_manuform_5x6/Kconfig.defconfig
```kconfig
if SHIELD_SHIELD_DACTYL_MANUFORM_5x6__DONGLE

config ZMK_KEYBOARD_NAME
    default "dactyl_manuform_dongle"

config ZMK_SPLIT_ROLE_CENTRAL
    default y

config ZMK_SPLIT
    default y

config ZMK_SPLIT_BLE_CENTRAL_PERIPHERALS
    default 2

endif
if SHIELD_DACTYL_MANUFORM_5x6_LEFT

    config ZMK_KEYBOARD_NAME
        default "TAIKO-DACTYL-L"

    config ZMK_SPLIT_BLE_ROLE_CENTRAL
        default n

endif

if SHIELD_DACTYL_MANUFORM_5x6_RIGHT

    config ZMK_KEYBOARD_NAME
        default "TAIKO-DACTYL-R"
    config ZMK_SPLIT_BLE_ROLE_CENTRAL
        default n

endif

if SHIELD_DACTYL_MANUFORM_5x6_LEFT || SHIELD_DACTYL_MANUFORM_5x6_RIGHT

    config ZMK_SPLIT
        default y

endif
```

## config/boards/shields/dactyl_manuform_5x6/Kconfig.shield
```kconfig
config SHIELD_DACTYL_MANUFORM_5x6_LEFT
    def_bool $(shields_list_contains,dactyl_manuform_5x6_left)

config SHIELD_DACTYL_MANUFORM_5x6_RIGHT
    def_bool $(shields_list_contains,dactyl_manuform_5x6_right)

# No whitespace after the comma or in your part name!
config SHIELD_DACTYL_MANUFORM_5x6__DONGLE
    def_bool $(shields_list_contains,SHIELD_DACTYL_MANUFORM_5x6__DONGLE)
```
