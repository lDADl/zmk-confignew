#include "dactyl_manuform_5x6.dtsi"
#include "dactyl_manuform_dongle.keymap"

/ {
    mock_kscan: mock_kscan_0 {
        compatible = "zmk,kscan-mock";
        columns = <0>;
        rows = <0>;
        events = <0>;
    };

    chosen {
        zmk,kscan = &mock_kscan;
        zmk,matrix_transform = &default_transform;
    };
};

&kscan0 {
    status = "disabled";
};
